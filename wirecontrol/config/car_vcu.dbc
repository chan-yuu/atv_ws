VERSION ""

NS_ :

BS_:

BU_: VCU IPC
VAL_TABLE_ Flag 1 "Active" 0 "Not Active" ;

BO_ 528 IPC_to_VCU_msg1: 8 IPC
 SG_ Target_turn_light : 57|2@1+ (1,0) [0|3] ""  VCU
 SG_ Target_steering_angle : 32|16@1- (1,0) [-32768|32767] "deg"  VCU
 SG_ Target_Fan_gear : 29|2@1+ (1,0) [0|3] ""  VCU
 SG_ Reserve_3 : 61|3@1+ (1,0) [0|7] ""  VCU
 SG_ Reserve_2 : 56|1@1+ (1,0) [0|1] ""  VCU
 SG_ Reserve_1 : 31|1@1+ (1,0) [0|1] ""  VCU
 SG_ Door_control : 59|2@1+ (1,0) [0|3] ""  VCU
 SG_ brake_pressure_request : 49|7@1+ (1,0) [0|127] ""  VCU
 SG_ brake_enable : 48|1@1+ (1,0) [0|1] ""  VCU
 SG_ throttle_opening : 8|16@1- (0.1,0) [-3276.8|3276.7] "%"  VCU
 SG_ speed_range : 6|2@1+ (1,0) [0|3] ""  VCU
 SG_ Head_control : 24|3@1+ (1,0) [0|7] ""  VCU
 SG_ Engine_power : 27|2@1+ (1,0) [0|3] ""  VCU
 SG_ cotton_unloading : 4|1@1+ (1,0) [0|1] ""  VCU
 SG_ cotton_picker_enable : 3|1@1+ (1,0) [0|1] ""  VCU
 SG_ cotton_box_control : 0|3@1+ (1,0) [0|7] ""  VCU
 SG_ auto_enable : 5|1@1+ (1,0) [0|1] ""  VCU

VAL_ 528 cotton_unloading 1 "Active" 0 "Not Active" ;
VAL_ 528 cotton_picker_enable 1 "Active" 0 "Not Active" ;
VAL_ 528 auto_enable 1 "Active" 0 "Not Active" ;
